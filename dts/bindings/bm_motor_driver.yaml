## dts/bindings/bm_motor_driver.yaml
```yaml
description: Motor driver gpio

compatible: "bm_motor_driver"

include: base.yaml

properties:
    stby-gpios:
      required: true
      type: phandle-array
      description: Driver specific pin
```

## dts/bindings/sensirion,bm_sgp40.yaml
```yaml
#
# Copyright (c) 2021, Leonard Pollak
#
# SPDX-License-Identifier: Apache-2.0

description: Sensirion SGP40 Multipixel Gas Sensor

compatible: "sensirion,bm_sgp40"

include: [sensor-device.yaml, i2c-device.yaml]


properties:
  temperature:
    type: uint8-array
    default: [0x66, 0x66, 0x93] #25 degrees + CRC
    description: Temperature compensation. 

  relative-humidity:
    type: uint8-array
    default: [0x80, 0x00, 0xa2] #50 % + CRC
    description: Humidity compensation.
```

## dts/bindings/sitronix,bm_st7735.yaml
```yaml
# Copyright (c) 2020, Kim Bøndergaard <kim@fam-boendergaard.dk>
# SPDX-License-Identifier: Apache-2.0

description: ST7735 128x128 display. Consist of a ST7735R 132x162 Display Controller and pin adapter including 74HC4050 Level Shifter. 

compatible: "sitronix,bm_st7735"

include: [spi-device.yaml, display-controller.yaml]

properties:
  reset-gpios:
    type: phandle-array
    description: RESET pin.

      The RESET pin of ST7735R is active low.
      If connected directly the MCU pin should be configured
      as active low.

  cmd-data-gpios:
    type: phandle-array
    required: true
    description: D/CX pin.

      The D/CX pin of ST7735R is active low (transmission command byte).
      If connected directly the MCU pin should be configured
      as active low.

  x-offset:
    type: int
    required: true
    description: The column offset in pixels of the LCD to the controller memory

  y-offset:
    type: int
    required: true
    description: The row offset in pixels of the LCD to the controller memory

  madctl:
    type: int
    default: 0x00
    description: Memory Data Access Control

  colmod:
    type: int
    default: 0x06
    description: Interface Pixel Format

  pwctr1:
    type: uint8-array
    default: [0x82, 0x02, 0x84]
    description: Power Control 1 Parameter

  pwctr2:
    type: uint8-array
    default: [0xc5]
    description: Power Control 2 Parameter

  pwctr3:
    type: uint8-array
    default: [0x0a, 0x00]
    description: Power Control 3 Parameter

  pwctr4:
    type: uint8-array
    default: [0x8a, 0x2e]
    description: Power Control 4 Parameter

  pwctr5:
    type: uint8-array
    default: [0x8a, 0xaa]
    description: Power Control 5 Parameter

  gmctrp1:
    type: uint8-array
    required: true
    description: Positive Voltage Gamma Control Parameter

  gmctrn1:
    type: uint8-array
    required: true
    description: Negative Voltage Gamma Control Parameter

  frmctr1:
    type: uint8-array
    default: [0x01, 0x2c, 0x2d]
    description: Frame rate control (normal mode / full colors)

  frmctr2:
    type: uint8-array
    default: [0x01, 0x2c, 0x2d]
    description: Frame rate control (idle mode / 8 colors)

  frmctr3:
    type: uint8-array
    default: [0x01, 0x2c, 0x2d, 0x01, 0x2c, 0x2d]
    description: Frame rate control (partial mode / full colors)

  caset:
    type: uint8-array
    default: [0x00, 0x00, 0x00, 0x83]
    description: Column Address Set

  raset:
    type: uint8-array
    default: [0x00, 0x00, 0x00, 0xa1]
    description: Row Address Set

  vmctr1:
    type: int
    default: 0x04
    description: VCOM Control 1

  invctr:
    type: int
    default: 0x07
    description: |
      Display Inversion Control
      Set dot inversion or line inversion for each normal/idle/partial mode.

  inversion-on:
    type: boolean
    description: |
      Enable Display Inversion
      Make a drawing with the inverted color of the frame memory.

  rgb-is-inverted:
    type: boolean
    description: |
      Inverting color format order (RGB->BGR or BGR->RGB)
      In the case of enabling this option, API reports pixel-format in capabilities
      as the inverted value of the RGB pixel-format specified in MADCTL.
      This option is convenient for supporting displays with bugs
      where the actual color is different from the pixel format of MADCTL.
```

## dts/bindings/st,bm_lsm6dsox.yaml
```yaml
# Copyright (c) 2019 STMicroelectronics
# SPDX-License-Identifier: Apache-2.0

# Found in zephyr\dts\bindings\sensor\st,lsm6dso-i2c.yaml and zephyr\dts\bindings\sensor\st,lsm6dso32-i2c.yaml

description: |
    STMicroelectronics LSM6DSO 6-axis IMU (Inertial Measurement Unit) sensor
    accessed through I2C bus

compatible: "st,bm_lsm6dsox"

include: ["i2c-device.yaml", "st,lsm6dso-common.yaml"]
```
